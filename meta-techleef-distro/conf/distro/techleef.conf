## meta-techleef-distro/conf/distro/techleef.conf
```bitbake
DISTRO = "techleef"
DISTRO_NAME = "Techleef Reference distribution"

DISTRO_VERSION = "1.0"

DISTRO_CODENAME = "scarthgab"

INIT_MANAGER = "systemd"


#use one tmp dorectory 
TCLIBCAPPEND = ""

#Minimize GPLv3 package 
require conf/distro/include/no-gplv3.inc

#Enhance security options for CFLAGS/LDFLAGS 
require conf/distro/include/security_flags.inc

# DISTRO FEATURES 
DISTRO_FEATURES = "\
    acl \
    ext2 \ 
    ipv4 \
    ipv6 \
    usbhost \
    wifi \
    xattr \
    zeroconf \
    vfat \ 
    seccomp \
    systemd \
    usrmerge \
"
```
